#include "oled.h"
#include <string.h>
#include <stdio.h>

/*
 * 说明：
 * 1. 适用于 SSD1306 128x64 I2C OLED
 * 2. HAL I2C 使用 hi2c1
 * 3. OLED 常见 7-bit 地址为 0x3C，因此 HAL 发送地址写成 0x3C << 1
 */
#define OLED_I2C_ADDR   (0x3C << 1)

extern I2C_HandleTypeDef hi2c1;

/* 显存缓存区: 128 x 64 / 8 = 1024 字节 */
static uint8_t OLED_GRAM[OLED_WIDTH][8];

/* 6x8 ASCII 字库，32~127 */
static const uint8_t OLED_F6x8[][6] =
{
    {0x00,0x00,0x00,0x00,0x00,0x00}, // ' '
    {0x00,0x00,0x5F,0x00,0x00,0x00}, // !
    {0x00,0x07,0x00,0x07,0x00,0x00}, // "
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    {0x00,0x00,0x00,0x00,0x00,0x00}
};

static void OLED_WriteCmd(uint8_t cmd)
{
    uint8_t data[2];
    data[0] = 0x00;
    data[1] = cmd;
    HAL_I2C_Master_Transmit(&hi2c1, OLED_I2C_ADDR, data, 2, HAL_MAX_DELAY);
}

static void OLED_WriteData(uint8_t *data, uint16_t size)
{
    uint8_t buf[129];
    if (size > 128) return;

    buf[0] = 0x40;
    memcpy(&buf[1], data, size);
    HAL_I2C_Master_Transmit(&hi2c1, OLED_I2C_ADDR, buf, size + 1, HAL_MAX_DELAY);
}

void OLED_SetCursor(uint8_t x, uint8_t page)
{
    OLED_WriteCmd(0xB0 + page);
    OLED_WriteCmd(0x10 | ((x & 0xF0) >> 4));
    OLED_WriteCmd(0x00 | (x & 0x0F));
}

void OLED_Refresh(void)
{
    for (uint8_t page = 0; page < 8; page++)
    {
        OLED_SetCursor(0, page);
        OLED_WriteData(OLED_GRAM[0] + page * 0, 0); // 防止警告占位
        HAL_I2C_Master_Transmit(&hi2c1, OLED_I2C_ADDR, (uint8_t[]){0x00, (uint8_t)(0xB0 + page), 0x00, 0x10}, 4, HAL_MAX_DELAY);

        uint8_t line[129];
        line[0] = 0x40;
        for (uint8_t x = 0; x < 128; x++)
        {
            line[x + 1] = OLED_GRAM[x][page];
        }
        HAL_I2C_Master_Transmit(&hi2c1, OLED_I2C_ADDR, line, 129, HAL_MAX_DELAY);
    }
}

void OLED_Clear(void)
{
    memset(OLED_GRAM, 0x00, sizeof(OLED_GRAM));
    OLED_Refresh();
}

void OLED_Fill(uint8_t data)
{
    memset(OLED_GRAM, data, sizeof(OLED_GRAM));
    OLED_Refresh();
}

void OLED_ShowChar(uint8_t x, uint8_t y, char chr)
{
    if (chr < ' ' || chr > '~') chr = '?';
    if (x > 122 || y > 7) return;

    const uint8_t *font = OLED_F6x8[chr - ' '];
    for (uint8_t i = 0; i < 6; i++)
    {
        OLED_GRAM[x + i][y] = font[i];
    }
}

void OLED_ShowString(uint8_t x, uint8_t y, char *str)
{
    while (*str)
    {
        OLED_ShowChar(x, y, *str++);
        x += 6;
        if (x > 122)
        {
            x = 0;
            y++;
            if (y > 7) break;
        }
    }
}

void OLED_ShowNum(uint8_t x, uint8_t y, int num)
{
    char buf[16];
    sprintf(buf, "%d", num);
    OLED_ShowString(x, y, buf);
}

void OLED_Init(void)
{
    HAL_Delay(100);

    OLED_WriteCmd(0xAE); // Display OFF

    OLED_WriteCmd(0xD5);
    OLED_WriteCmd(0x80);

    OLED_WriteCmd(0xA8);
    OLED_WriteCmd(0x3F);

    OLED_WriteCmd(0xD3);
    OLED_WriteCmd(0x00);

    OLED_WriteCmd(0x40);

    OLED_WriteCmd(0xA1);
    OLED_WriteCmd(0xC8);

    OLED_WriteCmd(0xDA);
    OLED_WriteCmd(0x12);

    OLED_WriteCmd(0x81);
    OLED_WriteCmd(0xCF);

    OLED_WriteCmd(0xD9);
    OLED_WriteCmd(0xF1);

    OLED_WriteCmd(0xDB);
    OLED_WriteCmd(0x30);

    OLED_WriteCmd(0xA4);
    OLED_WriteCmd(0xA6);

    OLED_WriteCmd(0x8D);
    OLED_WriteCmd(0x14);

    OLED_WriteCmd(0x20);
    OLED_WriteCmd(0x00);

    OLED_WriteCmd(0xAF); // Display ON

    OLED_Clear();
}
